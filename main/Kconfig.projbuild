## main/Kconfig.projbuild
```kconfig
menu "Project Configuration"
    menu "LoRaWAN"
        config LORAWAN_DEVEUI
            string "LoRaWAN deveui"
            default "XXXXXXXXXXXXXXXX"
            help
                Deveui read from the LoRaWAN module.
            config LORAWAN_APPEUI
                string "LoRaWAN appeui"
                default "XXXXXXXXXXXXXXXX"
                help
                    appeui from loriot.
            config LORAWAN_APPKEY
                string "LoRaWAN appkey"
                default "XXXXXXXXXXXXXXXXXXXXXXXXXXXXXXXX"
                help
                    appkey from Loriot.
    endmenu

endmenu
```
